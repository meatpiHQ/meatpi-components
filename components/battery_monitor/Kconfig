## components/battery_monitor/Kconfig
```kconfig
menu "WiCAN battery_monitor"

config WICAN_BATT_ADC_CHANNEL
    int "Battery sense ADC1 channel"
    default 3
    help
        ADC unit 1 channel wired to the battery divider (WiCAN Pro:
        channel 3 = GPIO4). Per-hardware-revision; override in the
        board's sdkconfig.

config WICAN_BATT_DIVIDER_X100
    int "Battery divider ratio x100"
    default 1100
    help
        Volts at the battery per volt at the ADC pin, times 100
        (WiCAN Pro: 11.00 -> 1100).

config WICAN_BATT_OFFSET_MV
    int "Battery reading offset (mV at the battery)"
    default 100
    help
        Constant offset added to the scaled reading, in millivolts
        (field calibration; WiCAN Pro: +100 mV, from the legacy
        firmware's bench calibration).

endmenu
```

## components/can_manager/Kconfig
```kconfig
menu "WiCAN CAN manager"

    config WICAN_CAN_TX_GPIO
        int "CAN (TWAI) TX GPIO"
        default 2
        help
            WiCAN Pro: GPIO2 (legacy hw_config.h TX_GPIO_NUM).

    config WICAN_CAN_RX_GPIO
        int "CAN (TWAI) RX GPIO"
        default 1
        help
            WiCAN Pro: GPIO1 (legacy hw_config.h RX_GPIO_NUM).

    config WICAN_CAN_STDBY_GPIO
        int "CAN transceiver standby GPIO"
        default 38
        help
            Driven LOW while the bus is up, HIGH when parked. Same
            pin sleep_manager holds HIGH through light sleep (WiCAN
            Pro: GPIO38, legacy hw_config.h CAN_STDBY_GPIO_NUM).


    config WICAN_CAN_ISR_CORE
        int "TWAI interrupt + RX task core (0 or 1)"
        range 0 1
        default 0
        help
            Core the TWAI node registers its interrupt on (the driver
            binds the ISR to the core that runs the init call) and the
            can_core RX task is pinned to. Core 0 hosts WiFi/BT/USB by
            IDF default; 1 spreads the load and doubles the usable
            per-core interrupt-slot pool. Benchmark before shipping a
            change (2026-07-21 affinity experiment).

endmenu
```

## components/http_server_manager/Kconfig
```kconfig
menu "HTTP server manager"

    config HTTP_SERVER_MANAGER_STACK_PSRAM
        bool "Run the HTTP server task on a PSRAM stack"
        default y
        # IDF 6: the option that lets a task stack live in PSRAM is
        # FREERTOS_TASK_CREATE_ALLOW_EXT_MEM (SPIRAM_ALLOW_STACK_EXTERNAL_MEMORY
        # is its deprecated spelling and no longer a symbol)
        depends on FREERTOS_TASK_CREATE_ALLOW_EXT_MEM
        help
            The HTTP server task's 12 KB stack is allocated from PSRAM
            (esp_http_server's task_caps) instead of 8 KB of internal RAM.
            Every flash access a route handler makes (the settings files,
            the NVS records, an OTA upload, a /data stream) runs through
            the flash_jobs worker, so nothing on this task runs with the
            flash cache off. Switch off for a build that must keep the
            server's stack internal (then 8 KB, the 2026-09-22 size).

endmenu
```

## components/i2c_bus/Kconfig
```kconfig
menu "WiCAN i2c_bus"

config WICAN_I2C_SDA_GPIO
    int "I2C SDA GPIO"
    default 5
    help
        SDA pin of the shared peripheral I2C bus (WiCAN Pro: GPIO5).
        Per-hardware-revision; override in the board's sdkconfig.

config WICAN_I2C_SCL_GPIO
    int "I2C SCL GPIO"
    default 6
    help
        SCL pin of the shared peripheral I2C bus (WiCAN Pro: GPIO6).

endmenu
```

## components/mdns_manager/Kconfig
```kconfig
menu "WiCAN mdns_manager"

config WICAN_HW_VERSION
    string "Hardware version string"
    default "WiCAN-PRO"
    help
        Advertised in the mDNS TXT record `hardware` (and available to
        other surfaces). Per-hardware-revision; override in the board's
        sdkconfig.

config WICAN_DEVICE_TYPE
    string "Device type slug"
    default "wican_pro"
    help
        The MeatPi HA-integration profile slug (device-contract v2):
        lowercase, stable per product ("wican_pro", "wican_usb",
        "wican", "espnetlink", ...). Advertised in the mDNS TXT record
        `device_type` and returned by GET /api/info. Per-product;
        override in the board's sdkconfig.

config WICAN_MODEL_NAME
    string "Product model name"
    default "WiCAN Pro"
    help
        Human-readable model ("WiCAN Pro"). Returned by GET /api/info;
        shown in the HA device registry.

endmenu
```

## components/restart_tracker/Kconfig
```kconfig
menu "WiCAN restart_tracker"

    config WICAN_RESTART_TRACKER_PARK_RETRY_MIN
        int "Crash park: start again by itself after this many minutes (0 = never)"
        range 0 1440
        default 0
        help
            After three runs in a row that crashed before they settled, the
            crash-loop brake parks the device asleep (README.md, "The
            crash-loop brake"). With 0 it stays parked until the power is
            cycled or the button is pressed. Any other value makes a parked
            device try one normal start after that many minutes, and park
            again at once when that start crashes too.

endmenu
```

## components/sleep_manager/Kconfig
```kconfig
menu "WiCAN sleep_manager"

    config WICAN_SLEEP_CAN_STDBY_GPIO
        int "CAN transceiver standby GPIO"
        default 38
        help
            Driven HIGH on sleep entry (WiCAN Pro: GPIO38, legacy
            hw_config.h CAN_STDBY_GPIO_NUM).

    config WICAN_SLEEP_USB_PWR_GPIO
        int "USB OTG power-enable GPIO"
        default 10
        help
            Held LOW (open-drain + pulldown + gpio_hold) through the
            naps so the USB rail stays off (WiCAN Pro: GPIO10, legacy
            hw_config.h USB_OTG_PWR_EN).

endmenu
```

## components/usb_host_manager/Kconfig
```kconfig
menu "WiCAN usb_host_manager"

    config WICAN_USB_ID_GPIO
        int "USB OTG ID GPIO"
        default 39
        help
            Low (grounded by the OTG cable) = a device is attached
            (WiCAN Pro: GPIO39, legacy hw_config.h USB_ID_PIN).

    config WICAN_USB_MODE_GPIO
        int "USB mux mode GPIO"
        default 11
        help
            High routes the USB connector to the ESP32-S3 OTG host;
            low = the CH342 UART bridge / device role (WiCAN Pro:
            GPIO11, legacy hw_config.h USB_ESP_MODE_EN). VBUS uses
            WICAN_SLEEP_USB_PWR_GPIO (the shared power rail).

    config WICAN_USB_DEV_VID
        hex "USB device-mode Vendor ID"
        default 0x16D0
        help
            VID advertised when the connector runs in DEVICE role
            (role=device: CherryUSB CDC-NCM/RNDIS/CDC-ACM — the J2534
            USB transport, TASK_j2534_server.md §5). A host-side J2534
            DLL matches its device by VID/PID. 0x16D0 = MCS Electronics
            (shared VID pool).

    config WICAN_USB_DEV_PID
        hex "USB device-mode Product ID (NCM/RNDIS network device)"
        default 0x1262
        help
            PID advertised in DEVICE role with device_class=ncm|rndis
            (see WICAN_USB_DEV_VID).
            NOT 0x1261: that PID is the shipped MeatPi USB-CAN product,
            and its Windows INF claims VID_16D0&PID_1261&MI_00 as a COM
            port — it outranks the inbox class-match NCM driver and
            breaks enumeration on any PC that ever installed it
            (bench-hit 2026-07-08, Code 10).

    config WICAN_USB_DEV_PID_CDC
        hex "USB device-mode Product ID (CDC-ACM serial device)"
        default 0x1263
        help
            PID advertised in DEVICE role with device_class=cdc (the
            J2534-over-serial virtual COM port). MUST differ from
            WICAN_USB_DEV_PID: one PID per USB function, or Windows
            caches the wrong driver class across mode switches (the same
            Code 10 failure mode as 0x1261). 0x1263 confirmed safe for
            production by meatpi 2026-07-18.

endmenu
```

## components/web_ui_v2/Kconfig
```kconfig
menu "WiCAN built-in web UI"

choice WICAN_WEBUI
    prompt "Built-in web UI to compile + serve"
    default WICAN_WEBUI_V2
    help
        Which web front-end the firmware embeds and serves from the HTTP
        catch-all. Only one is compiled into flash. API routes always win
        over the UI, so "None" leaves the full /api + /ws surface working
        for a headless build or an external app.

    config WICAN_WEBUI_V2
        bool "v2 (single-page app, all features)"
        help
            The v2 UI in components/web_ui_v2 — a self-contained,
            responsive single-page app covering every /api feature.

    config WICAN_WEBUI_NONE
        bool "None (headless — API/WS only)"

endchoice

endmenu
```
