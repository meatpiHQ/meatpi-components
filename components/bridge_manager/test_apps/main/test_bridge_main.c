/**
 * @file test_bridge_main.c
 * @brief On-target test app for bridge_manager. Three legs:
 *
 *  1. STUB PUMP: a "src" -> "dst" raw bridge between stub endpoints proves
 *     ordered, lossless pumping and measures the pump ceiling (chunks/s +
 *     MB/s, printed for BENCHMARKS.md scenario 1).
 *  2. OVERFLOW: with a deliberately slow dst, the producing side's bounded
 *     queue fills — chunks drop-and-count at the PRODUCER (never blocking
 *     it), the pump survives, accounting stays exact.
 *  3. SOCKET E2E: a real TCP client on the lwIP loopback talks through
 *     socket_manager("tcp0") <-> bridge <-> "echo" stub endpoint — the full
 *     production path (socket -> bridge -> endpoint -> back) in one device.
 *
 * Config is persisted BEFORE the settings boot pass (set() then
 * settings_manager_start() — reboot-to-apply without a reboot).
 */
#include <stdio.h>
#include <string.h>

#include "esp_event.h"
#include "esp_heap_caps.h"
#include "esp_log.h"
#include "esp_netif.h"
#include "esp_timer.h"
#include "freertos/FreeRTOS.h"
#include "freertos/queue.h"
#include "freertos/task.h"
#include "lwip/sockets.h"
#include "nvs_flash.h"

#include "bridge_manager.h"
#include "settings_manager.h"
#include "socket_manager.h"

static const char *TAG = "bridge_test";

_Static_assert(sizeof(bridge_chunk_t) == sizeof(socket_chunk_t),
               "chunk conventions diverged");

/* ---- stub endpoints ------------------------------------------------------------ */

/* src: RX is generated by the test; send() should never be called */
static QueueHandle_t s_src_sub;
static uint32_t s_src_drops;

static esp_err_t src_send(const uint8_t *d, size_t l)
{
    (void)d;
    (void)l;
    return ESP_OK;
}

static esp_err_t src_subscribe(QueueHandle_t q)
{
    s_src_sub = q;
    return ESP_OK;
}

static esp_err_t src_unsubscribe(QueueHandle_t q)
{
    (void)q;
    s_src_sub = NULL;
    return ESP_OK;
}

/* dst: counts/validates what the pump delivers; optional slow mode */
static uint32_t s_dst_bytes;
static uint32_t s_dst_chunks;
static bool     s_dst_in_order = true;
static uint8_t  s_dst_expect_seq;
static uint32_t s_dst_delay_ms;

static esp_err_t dst_send(const uint8_t *d, size_t l)
{
    if (l > 0 && d[0] != s_dst_expect_seq)
    {
        s_dst_in_order = false;
    }

    s_dst_expect_seq = (uint8_t)(d[0] + 1);
    s_dst_bytes += (uint32_t)l;
    s_dst_chunks++;

    if (s_dst_delay_ms > 0)
    {
        vTaskDelay(pdMS_TO_TICKS(s_dst_delay_ms));
    }

    return ESP_OK;
}

static esp_err_t dst_subscribe(QueueHandle_t q)
{
    (void)q;
    return ESP_OK; /* dst never produces */
}

static esp_err_t dst_unsubscribe(QueueHandle_t q)
{
    (void)q;
    return ESP_OK;
}

/* echo: send() loops the data straight back through its subscriber queue */
static QueueHandle_t s_echo_sub;

static esp_err_t echo_send(const uint8_t *d, size_t l)
{
    if (s_echo_sub == NULL)
    {
        return ESP_ERR_INVALID_STATE;
    }

    bridge_chunk_t chunk;

    while (l > 0)
    {
        size_t n = (l > BRIDGE_MANAGER_CHUNK_SIZE) ? BRIDGE_MANAGER_CHUNK_SIZE
                                                   : l;

        chunk.len = (uint16_t)n;
        memcpy(chunk.data, d, n);

        if (xQueueSend(s_echo_sub, &chunk, 0) != pdTRUE)
        {
            return ESP_FAIL;
        }

        d += n;
        l -= n;
    }

    return ESP_OK;
}

static esp_err_t echo_subscribe(QueueHandle_t q)
{
    s_echo_sub = q;
    return ESP_OK;
}

static esp_err_t echo_unsubscribe(QueueHandle_t q)
{
    (void)q;
    s_echo_sub = NULL;
    return ESP_OK;
}

/* N parallel src->dst pairs for the concurrency/fairness leg
 * (BENCHMARKS §3). Endpoint vtables carry no ctx, so instances are
 * macro-stamped. */
#define MPAIRS 2
static QueueHandle_t s_msrc_sub[MPAIRS];
static uint32_t s_mdst_chunks[MPAIRS];
static uint32_t s_mdst_delay_ms;

#define MK_PAIR(i)                                                          \
    static esp_err_t msrc##i##_send(const uint8_t *d, size_t l)             \
    { (void)d; (void)l; return ESP_OK; }                                    \
    static esp_err_t msrc##i##_sub(QueueHandle_t q)                         \
    { s_msrc_sub[i] = q; return ESP_OK; }                                   \
    static esp_err_t msrc##i##_unsub(QueueHandle_t q)                       \
    { (void)q; s_msrc_sub[i] = NULL; return ESP_OK; }                       \
    static esp_err_t mdst##i##_send(const uint8_t *d, size_t l)             \
    { (void)d; (void)l; s_mdst_chunks[i]++;                                 \
      if (s_mdst_delay_ms) vTaskDelay(pdMS_TO_TICKS(s_mdst_delay_ms));      \
      return ESP_OK; }                                                      \
    static esp_err_t mdst##i##_sub(QueueHandle_t q)                         \
    { (void)q; return ESP_OK; }                                             \
    static esp_err_t mdst##i##_unsub(QueueHandle_t q)                       \
    { (void)q; return ESP_OK; }

MK_PAIR(0)
MK_PAIR(1)

/* socket glue: the three-line endpoint wrap the spec promises */
static esp_err_t tcp0_send(const uint8_t *d, size_t l)
{
    return socket_manager_send("tcp0", d, l);
}

static esp_err_t tcp0_subscribe(QueueHandle_t q)
{
    return socket_manager_subscribe("tcp0", q);
}

static esp_err_t tcp0_unsubscribe(QueueHandle_t q)
{
    return socket_manager_unsubscribe("tcp0", q);
}

/* ---- helpers --------------------------------------------------------------------- */

/** Push @p count sequenced chunks into src's subscriber queue (its "RX");
 *  returns how many were dropped because the bridge queue was full. */
static uint32_t generate(int count, uint32_t gap_ticks)
{
    bridge_chunk_t chunk = { .len = BRIDGE_MANAGER_CHUNK_SIZE };
    uint32_t drops = 0;

    for (int i = 0; i < count; i++)
    {
        chunk.data[0] = (uint8_t)i;

        if (xQueueSend(s_src_sub, &chunk, gap_ticks) != pdTRUE)
        {
            drops++; /* producer-side drop-and-count, never block */
        }
    }

    return drops;
}

static int connect_tcp(uint16_t port)
{
    int fd = socket(AF_INET, SOCK_STREAM, IPPROTO_TCP);
    struct sockaddr_in a =
    {
        .sin_family = AF_INET,
        .sin_port = htons(port),
    };

    a.sin_addr.s_addr = inet_addr("127.0.0.1");

    if (connect(fd, (struct sockaddr *)&a, sizeof(a)) != 0)
    {
        close(fd);
        return -1;
    }

    struct timeval tv = { .tv_sec = 2, .tv_usec = 0 };

    setsockopt(fd, SOL_SOCKET, SO_RCVTIMEO, &tv, sizeof(tv));
    return fd;
}

void app_main(void)
{
    esp_err_t err = nvs_flash_init();

    if (err == ESP_ERR_NVS_NO_FREE_PAGES ||
        err == ESP_ERR_NVS_NEW_VERSION_FOUND)
    {
        ESP_ERROR_CHECK(nvs_flash_erase());
        err = nvs_flash_init();
    }

    ESP_ERROR_CHECK(err);
    ESP_ERROR_CHECK(esp_netif_init());
    ESP_ERROR_CHECK(esp_event_loop_create_default());

    /* ---- compose like main -------------------------------------------- */
    ESP_ERROR_CHECK(settings_manager_init());
    ESP_ERROR_CHECK(socket_manager_init());
    err = bridge_manager_init();
    printf("INIT ok=%d\n", err == ESP_OK);

    static const bridge_endpoint_t SRC =
        { "src", src_send, src_subscribe, src_unsubscribe };
    static const bridge_endpoint_t DST =
        { "dst", dst_send, dst_subscribe, dst_unsubscribe };
    static const bridge_endpoint_t ECHO =
        { "echo", echo_send, echo_subscribe, echo_unsubscribe };
    static const bridge_endpoint_t TCP0 =
        { "tcp0", tcp0_send, tcp0_subscribe, tcp0_unsubscribe };

    ESP_ERROR_CHECK(bridge_manager_register_endpoint(&SRC));
    ESP_ERROR_CHECK(bridge_manager_register_endpoint(&DST));
    ESP_ERROR_CHECK(bridge_manager_register_endpoint(&ECHO));
    ESP_ERROR_CHECK(bridge_manager_register_endpoint(&TCP0));

    /* the four concurrency pairs (§3 leg) */
    static const bridge_endpoint_t MEP[MPAIRS * 2] =
    {
        { "msrc0", msrc0_send, msrc0_sub, msrc0_unsub },
        { "mdst0", mdst0_send, mdst0_sub, mdst0_unsub },
        { "msrc1", msrc1_send, msrc1_sub, msrc1_unsub },
        { "mdst1", mdst1_send, mdst1_sub, mdst1_unsub },
    };

    for (int i = 0; i < MPAIRS * 2; i++)
    {
        ESP_ERROR_CHECK(bridge_manager_register_endpoint(&MEP[i]));
    }
    printf("ENDPOINTS ok=1 dup_rejected=%d\n",
           bridge_manager_register_endpoint(&SRC) != ESP_OK);

    /* persist server + bridge config BEFORE the boot pass */
    cJSON *cfg = cJSON_Parse(
        "{\"servers\":[{\"name\":\"tcp0\",\"proto\":\"tcp\",\"port\":3333,"
        "\"max_clients\":2,\"enabled\":true}]}");

    ESP_ERROR_CHECK(settings_manager_set("socket_manager", cfg, NULL, 0,
                                         NULL));
    cJSON_Delete(cfg);

    cfg = cJSON_Parse(
        "{\"bridges\":["
        "{\"name\":\"br0\",\"a\":\"src\",\"b\":\"dst\",\"enabled\":true},"
        "{\"name\":\"br1\",\"a\":\"tcp0\",\"b\":\"echo\",\"enabled\":true},"
        "{\"name\":\"mbr0\",\"a\":\"msrc0\",\"b\":\"mdst0\",\"enabled\":true},"
        "{\"name\":\"mbr1\",\"a\":\"msrc1\",\"b\":\"mdst1\",\"enabled\":true}"
        "]}");

    char errbuf[96] = "";

    err = settings_manager_set("bridge_manager", cfg, errbuf, sizeof(errbuf),
                               NULL);
    cJSON_Delete(cfg);
    printf("CFG ok=%d err='%s'\n", err == ESP_OK, errbuf);

    ESP_ERROR_CHECK(settings_manager_start()); /* boot pass -> on_apply */
    ESP_ERROR_CHECK(socket_manager_start());
    err = bridge_manager_start();
    printf("START ok=%d\n", err == ESP_OK);
    vTaskDelay(pdMS_TO_TICKS(500));

    /* runtime PUTs are strict (registry-aware on_validate) — an unknown
     * endpoint must be rejected AND must not clobber the live config.
     * (Pre-start sets are deliberately lenient: dynamic jacks register
     * between the boot pass and start — do NOT probe this before start,
     * a lenient accept would overwrite the good config.) */
    cfg = cJSON_Parse(
        "{\"bridges\":[{\"name\":\"bad\",\"a\":\"nope\",\"b\":\"dst\","
        "\"enabled\":true}]}");
    err = settings_manager_set("bridge_manager", cfg, errbuf, sizeof(errbuf),
                               NULL);
    cJSON_Delete(cfg);
    printf("CFG-BAD rejected=%d\n", err != ESP_OK);

    /* ---- leg 1: ordered lossless pump + ceiling ------------------------- */
    const int N = 2000;
    int64_t t0 = esp_timer_get_time();
    uint32_t drops = generate(N, pdMS_TO_TICKS(20));

    /* wait for the pump to drain */
    for (int i = 0; i < 100 && s_dst_chunks < (uint32_t)(N - drops); i++)
    {
        vTaskDelay(pdMS_TO_TICKS(20));
    }

    int64_t us = esp_timer_get_time() - t0;
    uint32_t moved = s_dst_chunks;

    printf("PUMP ok=%d in_order=%d drops=%u\n",
           moved == (uint32_t)N && drops == 0, s_dst_in_order,
           (unsigned)drops);
    printf("PUMP-CEILING chunks_per_s=%u kbytes_per_s=%u\n",
           (unsigned)((uint64_t)moved * 1000000 / us),
           (unsigned)((uint64_t)s_dst_bytes * 1000000 / us / 1024));

    /* ---- leg 2: overflow drop-and-count under a slow consumer ----------- */
    s_dst_delay_ms = 20;
    s_dst_chunks = 0;
    s_dst_expect_seq = 0;
    s_dst_in_order = true;
    drops = generate(200, 0); /* flood with zero-wait sends */
    vTaskDelay(pdMS_TO_TICKS(2000));
    s_dst_delay_ms = 0;

    bridge_stats_t bstats;

    bridge_manager_stats("br0", &bstats);
    printf("OVERFLOW drops_gt0=%d pump_alive=%d accounted=%d\n", drops > 0,
           bstats.a2b_chunks > 0, s_dst_chunks <= 200 - drops + 64);

    /* ---- leg 3: TCP client <-> bridge <-> echo endpoint ------------------ */
    int fd = connect_tcp(3333);

    vTaskDelay(pdMS_TO_TICKS(300));

    const char *msg = "ping-through-bridge";
    char buf[64];

    send(fd, msg, strlen(msg), 0);

    int n = recv(fd, buf, sizeof(buf) - 1, 0);

    buf[(n > 0) ? n : 0] = '\0';
    printf("E2E ok=%d match=%d\n", n == (int)strlen(msg),
           strcmp(buf, msg) == 0);
    close(fd);

    bridge_manager_stats("br1", &bstats);
    printf("STATS br1 a2b=%u b2a=%u errors=%u\n",
           (unsigned)bstats.a2b_chunks, (unsigned)bstats.b2a_chunks,
           (unsigned)bstats.send_errors);

    /* ---- leg 4: concurrency — 4 bridges under equal offered load (§3) --- */
    {
        bridge_chunk_t mchunk = { .len = BRIDGE_MANAGER_CHUNK_SIZE };

        memset((void *)s_mdst_chunks, 0, sizeof(s_mdst_chunks));

        int64_t mt0 = esp_timer_get_time();
        const int64_t mwindow_us = 5 * 1000000LL;

        while (esp_timer_get_time() - mt0 < mwindow_us)
        {
            for (int i = 0; i < MPAIRS; i++)
            {
                if (s_msrc_sub[i] != NULL)
                {
                    (void)xQueueSend(s_msrc_sub[i], &mchunk, 0);
                }
            }
        }

        vTaskDelay(pdMS_TO_TICKS(500)); /* drain */

        int64_t mus = esp_timer_get_time() - mt0;
        uint32_t agg = 0, mn = UINT32_MAX;

        for (int i = 0; i < MPAIRS; i++)
        {
            agg += s_mdst_chunks[i];

            if (s_mdst_chunks[i] < mn)
            {
                mn = s_mdst_chunks[i];
            }
        }

        printf("CONC bridges=%d agg_chunks_per_s=%u min_chunks_per_s=%u "
               "fair=%d\n", MPAIRS,
               (unsigned)((uint64_t)agg * 1000000 / mus),
               (unsigned)((uint64_t)mn * 1000000 / mus),
               mn * MPAIRS * 10 >= agg * 5); /* min >= 50%% of fair share */
    }

    /* ---- leg 5: 60 s overload, heap high-water (§4) ---------------------- */
    {
        uint32_t heap_before =
            (uint32_t)heap_caps_get_free_size(MALLOC_CAP_INTERNAL);

        s_mdst_delay_ms = 20; /* slow ALL mdst consumers */
        s_dst_delay_ms = 20;
        s_dst_chunks = 0;

        bridge_chunk_t ochunk = { .len = BRIDGE_MANAGER_CHUNK_SIZE };
        uint64_t sent = 0, drops64 = 0;
        int64_t ot0 = esp_timer_get_time();

        while (esp_timer_get_time() - ot0 < 60 * 1000000LL)
        {
            if (xQueueSend(s_src_sub, &ochunk, 0) != pdTRUE)
            {
                drops64++;
            }

            sent++;

            if ((sent & 0x3FF) == 0)
            {
                vTaskDelay(1); /* let the pump breathe */
            }
        }

        /* surviving-chunk latency bound = drain time of the full queue */
        uint32_t before_drain = s_dst_chunks;
        int64_t dt0 = esp_timer_get_time();

        s_mdst_delay_ms = 0;
        s_dst_delay_ms = 0;
        vTaskDelay(pdMS_TO_TICKS(1500));

        int64_t drain_ms = (esp_timer_get_time() - dt0) / 1000;
        uint32_t heap_after =
            (uint32_t)heap_caps_get_free_size(MALLOC_CAP_INTERNAL);

        bridge_manager_stats("br0", &bstats);
        printf("OVERLOAD60 heap_before=%u heap_after=%u leak=%d "
               "sent=%llu drops=%llu delivered=%u drained_in_ms<=%lld "
               "pump_alive=%d\n",
               (unsigned)heap_before, (unsigned)heap_after,
               (int)(heap_before - heap_after),
               (unsigned long long)sent, (unsigned long long)drops64,
               (unsigned)s_dst_chunks,
               (long long)drain_ms,
               s_dst_chunks > before_drain || bstats.a2b_chunks > 0);
    }

    /* ---- teardown is clean --------------------------------------------- */
    err = bridge_manager_stop();
    printf("STOP ok=%d\n", err == ESP_OK);

    ESP_LOGI(TAG, "suite complete");
    printf("TEST DONE\n");
}
